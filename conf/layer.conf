## conf/layer.conf
```bitbake
# We have a conf and classes directory, append to BBPATH
BBPATH .= ":${LAYERDIR}"

# We have a recipes directory, add to BBFILES
BBFILES += "${LAYERDIR}/recipes*/*/*.bb ${LAYERDIR}/recipes*/*/*.bbappend"

BBFILE_COLLECTIONS += "lts-nodejs-mixin"
BBFILE_PATTERN_lts-nodejs-mixin := "^${LAYERDIR}/"
BBFILE_PRIORITY_lts-nodejs-mixin = "6"

LAYERSERIES_COMPAT_lts-nodejs-mixin = "kirkstone"

LAYERDEPENDS_lts-nodejs-mixin = " \
    core \
"

NODE_VERSION ??= "20.%"

PREFERRED_VERSION_nodejs ??= "${NODE_VERSION}"
PREFERRED_VERSION_nodejs-oe-cache-native ??= "${NODE_VERSION}"
```
